&i2c19 {
	clock-frequency = <400000>;

	pinctrl-0 = <&qup_i2c19_data_clk>;
	pinctrl-names = "default";
	status = "okay";

	/*
	 * ELAN06FA
	 * Lenovo IdeaPad Slim 3x 15Q8X10 / machine type 83N3
	 */
	touchpad@15 {
		compatible = "hid-over-i2c";
		reg = <0x15>;

		hid-descr-addr = <0x1>;
		interrupts-extended = <&tlmm 19 IRQ_TYPE_LEVEL_LOW>;

		vdd-supply = <&vreg_misc_3p3>;
		vddl-supply = <&vreg_l12b_1p2>;

		wakeup-source;
	};
};
